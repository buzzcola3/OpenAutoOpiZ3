## external/Config.in
```kconfig
menu "OpenAuto external options"
	source "$BR2_EXTERNAL_OPENAUTO_PATH/package/openautocore/Config.in"
	source "$BR2_EXTERNAL_OPENAUTO_PATH/package/openautoflutter/Config.in"
	source "$BR2_EXTERNAL_OPENAUTO_PATH/package/debuglantern/Config.in"
endmenu
```

## external/configs/openauto_orangepi_zero3_defconfig
```kconfig
BR2_aarch64=y
BR2_ARM_FPU_VFPV4=y
BR2_TOOLCHAIN_BUILDROOT_CXX=y
BR2_PACKAGE_HOST_LINUX_HEADERS_CUSTOM_6_12=y
BR2_GLOBAL_PATCH_DIR="../external/board/orangepi/zero3/patches"
BR2_DOWNLOAD_FORCE_CHECK_HASHES=y
BR2_TARGET_GENERIC_ISSUE="Welcome to Orangepi Zero3"
BR2_ROOTFS_DEVICE_CREATION_DYNAMIC_DEVTMPFS=y
BR2_SYSTEM_DHCP="eth0"
BR2_SYSTEM_DEFAULT_PATH="/usr/bin:/usr/sbin:/bin:/sbin"
BR2_ENABLE_LOCALE_PURGE=y
BR2_ENABLE_LOCALE_WHITELIST="C en_US"
BR2_GENERATE_LOCALE="en_US.UTF-8"
BR2_INIT_SYSTEMD=y
BR2_ROOTFS_OVERLAY="../external/rootfs_overlay"
BR2_ROOTFS_POST_BUILD_SCRIPT="../external/board/orangepi/zero3/post-build.sh"
BR2_ROOTFS_POST_IMAGE_SCRIPT="support/scripts/genimage.sh"
BR2_ROOTFS_POST_SCRIPT_ARGS="-c $(BINARIES_DIR)/genimage.cfg"
BR2_LINUX_KERNEL=y
BR2_LINUX_KERNEL_CUSTOM_VERSION=y
BR2_LINUX_KERNEL_CUSTOM_VERSION_VALUE="6.12.66"
BR2_LINUX_KERNEL_USE_ARCH_DEFAULT_CONFIG=y
BR2_LINUX_KERNEL_DTS_SUPPORT=y
BR2_LINUX_KERNEL_INTREE_DTS_NAME="allwinner/sun50i-h618-orangepi-zero3"
BR2_LINUX_KERNEL_DTB_KEEP_DIRNAME=y
BR2_LINUX_KERNEL_CONFIG_FRAGMENT_FILES="../external/kernel-fragments/psplash_fbdev.fragment ../external/kernel-fragments/hdmi_cma.fragment ../external/kernel-fragments/h618_gpu_power.fragment ../external/kernel-fragments/no_boot_console.fragment"
BR2_LINUX_KERNEL_INSTALL_TARGET=y
BR2_LINUX_KERNEL_NEEDS_HOST_OPENSSL=y
BR2_TARGET_ROOTFS_EXT2=y
BR2_TARGET_ROOTFS_EXT2_4=y
BR2_TARGET_ROOTFS_EXT2_SIZE="1G"
# BR2_TARGET_ROOTFS_TAR is not set
BR2_TARGET_ARM_TRUSTED_FIRMWARE=y
BR2_TARGET_ARM_TRUSTED_FIRMWARE_CUSTOM_VERSION=y
BR2_TARGET_ARM_TRUSTED_FIRMWARE_CUSTOM_VERSION_VALUE="v2.11"
BR2_TARGET_ARM_TRUSTED_FIRMWARE_PLATFORM="sun50i_h616"
BR2_TARGET_UBOOT=y
BR2_TARGET_UBOOT_BUILD_SYSTEM_KCONFIG=y
BR2_TARGET_UBOOT_CUSTOM_VERSION=y
BR2_TARGET_UBOOT_CUSTOM_VERSION_VALUE="2024.10"
BR2_TARGET_UBOOT_BOARD_DEFCONFIG="orangepi_zero3"
BR2_TARGET_UBOOT_NEEDS_DTC=y
BR2_TARGET_UBOOT_NEEDS_PYLIBFDT=y
BR2_TARGET_UBOOT_NEEDS_OPENSSL=y
BR2_TARGET_UBOOT_NEEDS_GNUTLS=y
BR2_TARGET_UBOOT_NEEDS_ATF_BL31=y
BR2_TARGET_UBOOT_SPL=y
BR2_TARGET_UBOOT_SPL_NAME="u-boot-sunxi-with-spl.bin"
BR2_TARGET_UBOOT_CUSTOM_MAKEOPTS="SCP=/dev/null"
BR2_PACKAGE_HOST_GENIMAGE=y
BR2_PACKAGE_HOST_UBOOT_TOOLS=y
BR2_PACKAGE_OPENAUTOCORE=y
BR2_PACKAGE_OPENAUTOFLUTTER=y
BR2_PACKAGE_LIBDRM=y
BR2_PACKAGE_MESA3D=y
BR2_PACKAGE_MESA3D_LLVM=y
BR2_PACKAGE_MESA3D_DRIVER=y
BR2_PACKAGE_MESA3D_GALLIUM_DRIVER=y
BR2_PACKAGE_MESA3D_GALLIUM_DRIVER_SOFTPIPE=y
BR2_PACKAGE_MESA3D_GALLIUM_DRIVER_PANFROST=y
BR2_PACKAGE_MESA3D_OPENGL_EGL=y
BR2_PACKAGE_MESA3D_OPENGL_ES=y
BR2_PACKAGE_MESA3D_GBM=y
BR2_PACKAGE_VULKAN_LOADER=y
BR2_PACKAGE_LIBINPUT=y
BR2_PACKAGE_LIBXKBCOMMON=y
BR2_PACKAGE_XKEYBOARD_CONFIG=y
BR2_PACKAGE_SYSTEMD=y
BR2_PACKAGE_FONTCONFIG=y
BR2_PACKAGE_FREETYPE=y
BR2_PACKAGE_HARFBUZZ=y
BR2_PACKAGE_DEJAVU=y
BR2_PACKAGE_GSTREAMER1=y
BR2_PACKAGE_GST1_PLUGINS_BASE=y
BR2_PACKAGE_FFMPEG=y
BR2_PACKAGE_FFMPEG_SWSCALE=y
BR2_PACKAGE_LIBGTK3=y
BR2_PACKAGE_LIBEPOXY=y
BR2_PACKAGE_UTIL_LINUX=y
BR2_PACKAGE_UTIL_LINUX_LIBMOUNT=y
BR2_PACKAGE_PSPLASH=y
BR2_PACKAGE_PSPLASH_IMAGE="../external/psplash/splash.png"
# BR2_PACKAGE_PSPLASH_STARTUP_MSG is not set
BR2_PACKAGE_PSPLASH_FULL_SCREEN=y
```

## external/package/debuglantern/Config.in
```kconfig
config BR2_PACKAGE_DEBUGLANTERN
	bool "DebugLantern (prebuilt)"
	depends on BR2_aarch64
	help
	  Prebuilt DebugLantern daemon from GitHub releases.
	  Installs to /opt/DebugLantern.
```

## external/package/flutter_engine/Config.in
```kconfig
config BR2_PACKAGE_FLUTTER_ENGINE
	bool "Flutter engine (prebuilt, aarch64)"
	depends on BR2_aarch64
	help
	  Prebuilt Flutter engine shared library and ICU data.
```

## external/package/flutter_engine_prebuilt/Config.in
```kconfig
config BR2_PACKAGE_FLUTTER_ENGINE_PREBUILT
	bool "Flutter engine (prebuilt, aarch64)"
	depends on BR2_aarch64
	depends on BR2_TOOLCHAIN_USES_GLIBC
	depends on BR2_INSTALL_LIBSTDCPP
	help
	  Prebuilt Flutter engine shared library and ICU data.
```

## external/package/flutterpi/Config.in
```kconfig
config BR2_PACKAGE_FLUTTERPI
	bool "flutter-pi (prebuilt)"
	select BR2_PACKAGE_FLUTTER_ENGINE_PREBUILT
	select BR2_PACKAGE_LIBDRM
	select BR2_PACKAGE_MESA3D
	select BR2_PACKAGE_MESA3D_GBM
	select BR2_PACKAGE_MESA3D_EGL
	select BR2_PACKAGE_MESA3D_OPENGL_ES
	select BR2_PACKAGE_LIBINPUT
	select BR2_PACKAGE_LIBXKBCOMMON
	select BR2_PACKAGE_EUDEV
	select BR2_PACKAGE_FONTCONFIG
	select BR2_PACKAGE_FREETYPE
	select BR2_PACKAGE_HARFBUZZ
	select BR2_PACKAGE_DEJAVU
	help
	  flutter-pi binary for DRM/KMS-only Flutter apps.
```

## external/package/openautocore/Config.in
```kconfig
config BR2_PACKAGE_OPENAUTOCORE
	bool "OpenAutoCore (prebuilt)"
	help
	  Prebuilt OpenAutoCore binary from GitHub releases.
```

## external/package/openautoflutter/Config.in
```kconfig
config BR2_PACKAGE_OPENAUTOFLUTTER
	bool "OpenAutoFlutter (prebuilt flutter-pi bundle)"
	depends on BR2_aarch64
	select BR2_PACKAGE_LIBDRM
	select BR2_PACKAGE_MESA3D
	select BR2_PACKAGE_LIBINPUT
	select BR2_PACKAGE_LIBXKBCOMMON
	select BR2_PACKAGE_FONTCONFIG
	select BR2_PACKAGE_GSTREAMER1
	select BR2_PACKAGE_GST1_PLUGINS_BASE
	select BR2_PACKAGE_LIBGTK3
	select BR2_PACKAGE_LIBEPOXY
	select BR2_PACKAGE_FFMPEG
	select BR2_PACKAGE_HARFBUZZ
	select BR2_PACKAGE_SYSTEMD
	select BR2_PACKAGE_VULKAN_LOADER
	help
	  Prebuilt OpenAutoFlutter example app for flutter-pi (aarch64).
	  Installs to /opt/OpenAutoFlutter.
	  LLVM runtime libs (libc++, libc++abi, libunwind) are provided
	  via rootfs overlay in /usr/lib.
```
